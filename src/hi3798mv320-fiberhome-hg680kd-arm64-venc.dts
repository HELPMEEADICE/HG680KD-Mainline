// SPDX-License-Identifier: (GPL-2.0-only OR BSD-2-Clause)

#include "hi3798mv320-fiberhome-hg680kd-arm64-usb.dts"

&{/soc/usb@f98a0000} {
	status = "disabled";
};

/* The two pixel processors share the validated broadcast interrupt. */
&gpu {
	interrupts = <GIC_SPI 94 IRQ_TYPE_LEVEL_HIGH>,
		     <GIC_SPI 94 IRQ_TYPE_LEVEL_HIGH>,
		     <GIC_SPI 94 IRQ_TYPE_LEVEL_HIGH>,
		     <GIC_SPI 94 IRQ_TYPE_LEVEL_HIGH>,
		     <GIC_SPI 94 IRQ_TYPE_LEVEL_HIGH>,
		     <GIC_SPI 94 IRQ_TYPE_LEVEL_HIGH>,
		     <GIC_SPI 94 IRQ_TYPE_LEVEL_HIGH>,
		     <GIC_SPI 94 IRQ_TYPE_LEVEL_HIGH>;
	interrupt-names = "gp", "gpmmu", "pp0", "ppmmu0", "pp1", "ppmmu1", "pmu", "pp";
};
