// SPDX-License-Identifier: (GPL-2.0-only OR BSD-2-Clause)

#include "hi3798mv320-fiberhome-hg680kd.dts"

&{/soc} {
	crg: syscon@f8a22000 {
		compatible = "hisilicon,hi3798mv320-crg", "syscon";
		reg = <0xf8a22000 0x400>;
		#clock-cells = <1>;
		#reset-cells = <2>;
	};

	gpu: gpu@f9200000 {
		compatible = "arm,mali-450";
		reg = <0xf9200000 0x40000>;
		interrupts = <GIC_SPI 94 IRQ_TYPE_LEVEL_HIGH>,
			     <GIC_SPI 94 IRQ_TYPE_LEVEL_HIGH>,
			     <GIC_SPI 94 IRQ_TYPE_LEVEL_HIGH>,
			     <GIC_SPI 94 IRQ_TYPE_LEVEL_HIGH>,
			     <GIC_SPI 94 IRQ_TYPE_LEVEL_HIGH>,
			     <GIC_SPI 94 IRQ_TYPE_LEVEL_HIGH>,
			     <GIC_SPI 94 IRQ_TYPE_LEVEL_HIGH>,
			     <GIC_SPI 94 IRQ_TYPE_LEVEL_HIGH>;
		interrupt-names = "gp", "gpmmu", "pp0", "ppmmu0",
				  "pp1", "ppmmu1", "pmu", "pp";
		clocks = <&crg 0>, <&crg 1>;
		clock-names = "bus", "core";
		resets = <&crg 0xd4 4>;
	};
};
