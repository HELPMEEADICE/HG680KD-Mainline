// SPDX-License-Identifier: GPL-2.0-only
#include "hi3798mv320-fiberhome-hg680kd-arm64-vdp.dts"

&{/soc} {
	audio-controller@f8cd0000 {
		compatible = "hisilicon,hi3798mv320-aiao";
		reg = <0x0 0xf8cd0000 0x0 0x10000>;
		reg-names = "aiao";
		interrupts = <GIC_SPI 84 IRQ_TYPE_LEVEL_HIGH>;
		hisilicon,crg = <&crg>;
	};
};
