// SPDX-License-Identifier: (GPL-2.0-only OR BSD-2-Clause)

#include "hi3798mv320-fiberhome-hg680kd-arm64-vdec.dts"

&{/chosen} {
	/delete-node/ framebuffer@7f6c1000;
};

/* Give the native display driver card0 in the isolated RAM image. */
&gpu {
	status = "disabled";
};

&vdp {
	hisilicon,crg = <&crg>;
	/* Default CMA pool, direct 32-bit DMA. The VDP SMMU is bypassed. */
	status = "okay";
};
