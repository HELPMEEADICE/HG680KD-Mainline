// SPDX-License-Identifier: GPL-2.0-only
#include "hi3798mv320-fiberhome-hg680kd-arm64-aiao.dts"

/* Measured via GICR_ISPENDR0 on this board at EL2. */
&gic {
    interrupts = <GIC_PPI 9 IRQ_TYPE_LEVEL_HIGH>;
};

&{/timer} {
    interrupts = <GIC_PPI 13 IRQ_TYPE_LEVEL_HIGH>,
                 <GIC_PPI 14 IRQ_TYPE_LEVEL_HIGH>,
                 <GIC_PPI 11 IRQ_TYPE_LEVEL_HIGH>,
                 <GIC_PPI 10 IRQ_TYPE_LEVEL_HIGH>,
                 <GIC_PPI 12 IRQ_TYPE_LEVEL_HIGH>;
    interrupt-names = "sec-phys", "phys", "virt", "hyp-phys", "hyp-virt";
};
