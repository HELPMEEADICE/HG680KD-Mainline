
&{/soc} {
	video-encoder@f8c80000 {
		compatible = "hisilicon,hi3798mv320-venc-ram-probe";
		reg = <0x0 0xf8c80000 0x0 0xf000>,
		      <0x0 0xf8c8f000 0x0 0x1000>;
		interrupts = <0 101 4>;
		hisilicon,crg = <&crg>;
		resets = <&crg 0x32c 4>, <&crg 0x08c 4>;
		reset-names = "smmu", "core";
	};
};
